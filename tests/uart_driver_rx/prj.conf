## CMakeLists.txt
```
# SPDX-License-Identifier: Apache-2.0
# ZephyrUartDriver RX path on native_sim with the emulated UART (zephyr,uart-emul). The F´ component base class
# is replaced by a small stub (stubs/), so the real ZephyrUartDriver.cpp is compiled without the F´ build.

cmake_minimum_required(VERSION 3.20.0)

find_package(Zephyr REQUIRED HINTS $ENV{ZEPHYR_BASE})
project(fprime_zephyr_uart_driver_rx_test)

target_sources(app PRIVATE
    src/main.cpp
    src/tx.cpp
    ../../fprime-zephyr/Drv/ZephyrUartDriver/ZephyrUartDriver.cpp
)

# stubs/ first: it provides the autocoded base class and the few Fw headers the driver includes
target_include_directories(app PRIVATE
    stubs
    ../..
)
```

## prj.conf
```kconfig
CONFIG_ZTEST=y
CONFIG_CPP=y
CONFIG_STD_CPP17=y
CONFIG_SERIAL=y
CONFIG_UART_INTERRUPT_DRIVEN=y
CONFIG_EMUL=y
CONFIG_RING_BUFFER=y
# Same priority order as the target: the NUS UART's work queue (MAIN_THREAD_PRIORITY 0) runs above the 20 Hz
# rate group (priority 2) that calls schedIn. The test thread plays the rate group.
CONFIG_UART_EMUL_WORK_Q_PRIORITY=0
CONFIG_ZTEST_THREAD_PRIORITY=2
```

## app.overlay
```dts
/ {
	euart0: uart-emul {
		compatible = "zephyr,uart-emul";
		status = "okay";
		current-speed = <0>;
		rx-fifo-size = <4096>;
		tx-fifo-size = <256>;
	};

	/* TX tests (src/tx.cpp): a small TX FIFO that only the test drains, like a stalled BLE NUS link */
	euart1: uart-emul-tx {
		compatible = "zephyr,uart-emul";
		status = "okay";
		current-speed = <0>;
		rx-fifo-size = <64>;
		tx-fifo-size = <256>;
	};
};
```

## src/main.cpp
```c
// ZephyrUartDriver RX path on the emulated UART.
//
// Regression for the RX livelock seen on the nRF5340 DK (2026-10-30): an NTRIP RTCM uplink over BLE filled the
// driver's 1 KB ring, serial_cb throttled RX, and schedIn re-enabled RX before clearing m_rx_throttled. The NUS UART
// runs the callback on a work queue above the rate group, so serial_cb spun forever (RX pending but "throttled") and
// starved the application. uart_emul behaves the same way: its IRQ work keeps calling the callback while RX is enabled
// and data is pending, on a work queue above the test thread (prj.conf). With the old driver the throttle test never
// returns and twister fails it on the timeout.

#include <zephyr/device.h>
#include <zephyr/drivers/serial/uart_emul.h>
#include <zephyr/kernel.h>
#include <zephyr/ztest.h>

#include "fprime-zephyr/Drv/ZephyrUartDriver/ZephyrUartDriver.hpp"

namespace {
const struct device* const s_uart = DEVICE_DT_GET(DT_NODELABEL(euart0));

constexpr U32 POOL_SIZE = 2048;  // Position Cell / CRKT comms buffer bin size
U8 s_pool[POOL_SIZE];
bool s_no_buffer = false;

U8 s_rx[8192];
U32 s_rx_count = 0;
U32 s_recv_calls = 0;
U32 s_largest_recv = 0;
U8 s_next_tx = 0;  // next pattern byte written to the emulated RX line
U8 s_next_rx = 0;  // next pattern byte expected from recv

Zephyr::ZephyrUartDriver s_driver("uart");
bool s_configured = false;

void put_pattern(U32 count) {
    U8 chunk[256];
    while (count > 0U) {
        const U32 n = MIN(count, sizeof(chunk));
        for (U32 i = 0; i < n; i++) {
            chunk[i] = s_next_tx++;
        }
        zassert_equal(uart_emul_put_rx_data(s_uart, chunk, n), n, "emulated RX FIFO full");
        count -= n;
    }
}

// One rate-group tick: schedIn, then let the (higher-priority) UART work queue run
void tick() {
    s_driver.schedIn_handler(0, 0);
    k_sleep(K_MSEC(5));
}

void check_order(U32 from) {
    for (U32 i = from; i < s_rx_count; i++) {
        zassert_equal(s_rx[i], s_next_rx, "byte %u out of order", i);
        s_next_rx++;
    }
}

void before(void*) {
    if (!s_configured) {
        zassert_true(device_is_ready(s_uart));
        s_driver.configure(s_uart, 115200);
        s_configured = true;
    }
    s_no_buffer = false;
    // Drain whatever a previous test left: tick until a tick delivers nothing
    for (int i = 0; i < 50; i++) {
        const U32 before_count = s_rx_count;
        tick();
        if (s_rx_count == before_count) {
            break;
        }
    }
    s_next_rx = s_next_tx;
    s_rx_count = 0;
    s_recv_calls = 0;
    s_largest_recv = 0;
}
}  // namespace

namespace Zephyr {
Fw::Buffer test_allocate(U32 size) {
    if (s_no_buffer) {
        return Fw::Buffer();
    }
    return Fw::Buffer(s_pool, MIN(size, POOL_SIZE));
}

void test_deallocate(Fw::Buffer&) {}

void test_recv(Fw::Buffer& buffer, const Drv::ByteStreamStatus& status) {
    zassert_equal(status.e, Drv::ByteStreamStatus::OP_OK);
    zassert_true(s_rx_count + buffer.getSize() <= sizeof(s_rx));
    memcpy(&s_rx[s_rx_count], buffer.getData(), buffer.getSize());
    s_rx_count += buffer.getSize();
    s_recv_calls++;
    s_largest_recv = MAX(s_largest_recv, buffer.getSize());
}
}  // namespace Zephyr

ZTEST_SUITE(uart_driver_rx, nullptr, nullptr, before, nullptr, nullptr);

// Everything received since the last schedIn reaches recv in one buffer (was capped at 64 bytes per call).
ZTEST(uart_driver_rx, test_burst_drained_in_one_schedin) {
    put_pattern(900);
    k_sleep(K_MSEC(5));
    tick();
    zassert_equal(s_rx_count, 900U);
    zassert_equal(s_recv_calls, 1U);
    check_order(0);
}

// A burst larger than the ring throttles RX; schedIn drains and re-enables it without the callback spinning, and
// every byte arrives in order.
ZTEST(uart_driver_rx, test_throttle_recovers_without_livelock) {
    put_pattern(3000);
    k_sleep(K_MSEC(5));
    zassert_true(s_driver.m_rx_throttled, "a 3000-byte burst must fill the 1 KB ring");
    for (int i = 0; i < 20 && s_rx_count < 3000U; i++) {
        tick();
    }
    zassert_equal(s_rx_count, 3000U, "received %u of 3000", s_rx_count);
    zassert_false(s_driver.m_rx_throttled);
    zassert_true(s_largest_recv <= 1024U && s_largest_recv > 64U);
    check_order(0);
}

// No buffer from the allocator: the bytes stay in the ring and arrive on the next schedIn.
ZTEST(uart_driver_rx, test_no_buffer_keeps_data) {
    put_pattern(100);
    k_sleep(K_MSEC(5));
    s_no_buffer = true;
    tick();
    zassert_equal(s_rx_count, 0U);
    s_no_buffer = false;
    tick();
    zassert_equal(s_rx_count, 100U);
    check_order(0);
}
```

## src/tx.cpp
```c
// ZephyrUartDriver TX path on the emulated UART.
//
// Regression for the comQueue assert on the nRF5340 DK (2026-11-02): about 8 s after a BLE connect the NUS link
// drained slower than the downlink, send blocked in uart_poll_out (uart_bt sleeps while its TX ring is full), and
// ComQueue's thread sat in that send while the 20 Hz rate group and telemetry filled its 20-deep message queue. The
// status ComStub posts back to ComQueue when the send returns then found the queue full: FW_ASSERT, reboot.
// With setTxTimeout a send never waits longer than the timeout on a full TX FIFO, and never puts a partial frame on
// the wire (partial frames showed up as CRC errors on the host).

#include <zephyr/device.h>
#include <zephyr/drivers/serial/uart_emul.h>
#include <zephyr/kernel.h>
#include <zephyr/ztest.h>

#include "fprime-zephyr/Drv/ZephyrUartDriver/ZephyrUartDriver.hpp"

namespace {
const struct device* const s_uart = DEVICE_DT_GET(DT_NODELABEL(euart1));
constexpr U32 TX_FIFO = 256;  // app.overlay euart1 tx-fifo-size

Zephyr::ZephyrUartDriver s_tx_driver("uart_tx");
bool s_configured = false;
bool s_drain_in_callback = false;
U8 s_frame[600];
U8 s_out[1024];
U32 s_out_count = 0;

void drain() {
    s_out_count += uart_emul_get_tx_data(s_uart, &s_out[s_out_count], sizeof(s_out) - s_out_count);
}

// uart_emul calls this on every write: draining here models a link that keeps up
void tx_ready(const struct device*, size_t, void*) {
    if (s_drain_in_callback) {
        drain();
    }
}

void before(void*) {
    if (!s_configured) {
        zassert_true(device_is_ready(s_uart));
        s_tx_driver.configure(s_uart, 115200);
        uart_emul_callback_tx_data_ready_set(s_uart, tx_ready, nullptr);
        s_configured = true;
    }
    for (U32 i = 0; i < sizeof(s_frame); i++) {
        s_frame[i] = static_cast<U8>(i * 7U + 1U);
    }
    s_drain_in_callback = false;
    uart_emul_flush_tx_data(s_uart);
    s_out_count = 0;
    s_tx_driver.setTxTimeout(0U);
    s_tx_driver.m_tx_tail_len = 0;
    s_tx_driver.m_tx_tail_sent = 0;
    s_tx_driver.m_tx_dropped_frames = 0;
    s_tx_driver.m_tx_truncated_frames = 0;
}
}  // namespace

ZTEST_SUITE(uart_driver_tx, nullptr, nullptr, before, nullptr, nullptr);

// Default (no timeout): the blocking uart_poll_out path, unchanged
ZTEST(uart_driver_tx, test_default_path_sends_everything) {
    Fw::Buffer buf(s_frame, 200);
    zassert_equal(s_tx_driver.send_handler(0, buf).e, Drv::ByteStreamStatus::OP_OK);
    drain();
    zassert_equal(s_out_count, 200U);
    zassert_mem_equal(s_out, s_frame, 200);
}

// With a timeout and a link that keeps up, every byte goes out in order and nothing is dropped
ZTEST(uart_driver_tx, test_timeout_link_keeping_up_sends_everything) {
    s_tx_driver.setTxTimeout(20U);
    s_drain_in_callback = true;
    Fw::Buffer buf(s_frame, sizeof(s_frame));
    zassert_equal(s_tx_driver.send_handler(0, buf).e, Drv::ByteStreamStatus::OP_OK);
    zassert_equal(s_out_count, sizeof(s_frame), "sent %u of %u", s_out_count, (unsigned)sizeof(s_frame));
    zassert_mem_equal(s_out, s_frame, sizeof(s_frame));
    zassert_equal(s_tx_driver.m_tx_dropped_frames, 0U);
    zassert_equal(s_tx_driver.m_tx_tail_len, 0U);
}

// A stalled link: the send returns after about the timeout instead of blocking; the FIFO holds the head of the frame
// and the rest waits in the tail, so the frame is not cut short
ZTEST(uart_driver_tx, test_stalled_link_bounds_send_and_keeps_rest_of_frame) {
    s_tx_driver.setTxTimeout(20U);
    Fw::Buffer buf(s_frame, sizeof(s_frame));
    const int64_t start = k_uptime_get();
    zassert_equal(s_tx_driver.send_handler(0, buf).e, Drv::ByteStreamStatus::OP_OK);
    const int64_t took = k_uptime_get() - start;
    zassert_true(took >= 20 && took < 100, "send took %lld ms", took);
    drain();
    zassert_equal(s_out_count, TX_FIFO);
    zassert_mem_equal(s_out, s_frame, TX_FIFO);
    zassert_equal(s_tx_driver.m_tx_tail_len, sizeof(s_frame) - TX_FIFO);
    zassert_equal(s_tx_driver.m_tx_dropped_frames, 0U);
}

// The link recovers: the next send first completes the earlier frame, then sends its own, both whole and in order
ZTEST(uart_driver_tx, test_tail_completes_before_next_frame) {
    s_tx_driver.setTxTimeout(20U);
    Fw::Buffer buf(s_frame, sizeof(s_frame));
    (void)s_tx_driver.send_handler(0, buf);
    drain();
    s_drain_in_callback = true;
    Fw::Buffer next(&s_frame[8], 100);
    zassert_equal(s_tx_driver.send_handler(0, next).e, Drv::ByteStreamStatus::OP_OK);
    zassert_equal(s_out_count, sizeof(s_frame) + 100U);
    zassert_mem_equal(s_out, s_frame, sizeof(s_frame));
    zassert_mem_equal(&s_out[sizeof(s_frame)], &s_frame[8], 100);
    zassert_equal(s_tx_driver.m_tx_tail_len, 0U);
    zassert_equal(s_tx_driver.m_tx_dropped_frames, 0U);
}

// Still stalled when the next frame comes: the earlier frame keeps its place and the new one is dropped whole
// (SEND_RETRY), not interleaved
ZTEST(uart_driver_tx, test_new_frame_dropped_whole_while_tail_pending) {
    s_tx_driver.setTxTimeout(20U);
    Fw::Buffer buf(s_frame, sizeof(s_frame));
    (void)s_tx_driver.send_handler(0, buf);
    Fw::Buffer next(&s_frame[8], 100);
    zassert_equal(s_tx_driver.send_handler(0, next).e, Drv::ByteStreamStatus::SEND_RETRY);
    zassert_equal(s_tx_driver.m_tx_dropped_frames, 1U);
    drain();
    zassert_equal(s_out_count, TX_FIFO, "only the head of the first frame may be on the wire");
    zassert_mem_equal(s_out, s_frame, TX_FIFO);
}

// A full FIFO and no tail: nothing of the frame is queued, it is dropped whole
ZTEST(uart_driver_tx, test_full_fifo_drops_whole_frame) {
    s_tx_driver.setTxTimeout(20U);
    Fw::Buffer fill(s_frame, TX_FIFO);
    zassert_equal(s_tx_driver.send_handler(0, fill).e, Drv::ByteStreamStatus::OP_OK);
    zassert_equal(s_tx_driver.m_tx_tail_len, 0U);
    Fw::Buffer next(&s_frame[8], 50);
    zassert_equal(s_tx_driver.send_handler(0, next).e, Drv::ByteStreamStatus::SEND_RETRY);
    zassert_equal(s_tx_driver.m_tx_dropped_frames, 1U);
    drain();
    zassert_equal(s_out_count, TX_FIFO);
}
```
